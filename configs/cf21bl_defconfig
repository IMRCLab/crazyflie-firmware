## configs/cf21bl_defconfig
```kconfig
CONFIG_PLATFORM_CF21BL=y

CONFIG_MOTORS_REQUIRE_ARMING=y
CONFIG_MOTORS_ESC_PROTOCOL_DSHOT=y

CONFIG_MODIFY_CF_MASS=y
CONFIG_MODIFIED_CF_MASS=42700
```

## configs/cf21blrpm_defconfig
```kconfig
CONFIG_PLATFORM_CF21BL=y

CONFIG_MOTORS_REQUIRE_ARMING=y
CONFIG_MOTORS_ESC_PROTOCOL_DSHOT=y

CONFIG_DECK_RPM=y
CONFIG_DECK_FORCE="bcRpm"
CONFIG_MODIFY_CF_MASS=y
CONFIG_MODIFIED_CF_MASS=42700
```

## configs/cf2rpm_defconfig
```kconfig
CONFIG_PLATFORM_CF2=y
CONFIG_DECK_RPM=y
CONFIG_DECK_FORCE="bcRpm"
CONFIG_MODIFY_CF_MASS=y
CONFIG_MODIFIED_CF_MASS=36400
```
